## package/libpq/Config.in
```kconfig
config BR2_PACKAGE_LIBPQ
	bool "libpq"
	depends on BR2_USE_MMU
	depends on !BR2_STATIC_LIBS
	help
	  PostgreSQL C Library

	  http://www.postgresql.org/docs/9.4/static/libpq.html

comment "libpq needs a toolchain w/ dynamic library"
	depends on BR2_STATIC_LIBS
```

## package/pg_config/Config.in
```kconfig
config BR2_PACKAGE_PG_CONFIG
	bool "pg_config"
	depends on BR2_USE_MMU
	depends on !BR2_STATIC_LIBS
	help
	  PostgreSQL pg_config Binary

	  http://www.postgresql.org/docs/9.4/static

comment "libpq needs a toolchain w/ dynamic library"
	depends on BR2_STATIC_LIBS
```

## package/python-pip/Config.in
```kconfig
config BR2_PACKAGE_PYTHON_PIP
	bool "python-pip"
	depends on BR2_PACKAGE_PYTHON_SETUPTOOLS
	help
	  The PyPA recommended tool for installing Python packages.

	  https://pip.pypa.io/en/stable/
```
